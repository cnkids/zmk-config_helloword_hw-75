## config/boards/arm/hw75_dynamic/app/uart_comm/Kconfig
```kconfig
# Copyright (c) 2022-2023 XiNGRZ
# SPDX-License-Identifier: MIT

DT_ALIAS_UART_COMM := uart-comm

config HW75_UART_COMM
	bool
	select SERIAL
	select HW75_PROTO_UART_COMM
	default $(dt_alias_enabled,$(DT_ALIAS_UART_COMM))

if HW75_UART_COMM

config HW75_UART_COMM_THREAD_PRIORITY
	int
	default 10

config HW75_UART_COMM_THREAD_STACK_SIZE
	int
	default 1024

config HW75_UART_COMM_MAX_RX_MESSAGE_SIZE
	int
	default 64

config HW75_UART_COMM_FN_DEBOUNCE_MS
	int "FN state message debounce window in milliseconds"
	default 10
	help
	  FN state changes (pressed/released) are applied only after the
	  reported state stays stable for this window, filtering out noise
	  and bouncing on the keyboard side.

module = HW75_UART_COMM
module-str = uart_comm
source "subsys/logging/Kconfig.template.log_config"

endif # HW75_UART_COMM
```
